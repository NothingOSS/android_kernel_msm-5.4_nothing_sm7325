## drivers/nothing_stability/Kconfig
```kconfig
config NOTHING_BOOTLOADER_LOG
	tristate n
	default n
	help
		show booloader_log under proc/bootloader_log

config NOTHING_WRITRBACK_KMSG
	tristate n
	default n
	help
		The driver logs power-on to system_stage kmsg log.
		So it doesn't log any customer info.
		When the device is stuck. It can help us debug.
		Check the /sys/devices/virtual/NT/NT_reserve_kernel_log/boot_stage_systemserver is exist.

config NOTHING_STABILITY_TEST
	tristate "Nothing stability function tester"
	default n
	help
	  This driver can trigger some kernel issue cases(such as hang thread).

config NOTHING_RESTART_HANDLER
	tristate "Nothing power-off function enhance"
	default n
	help
	  store restart info into imem.
```

## drivers/nothing_thermal/Kconfig
```kconfig
#
# Generic thermal sysfs drivers configuration
#

config NOTHING_SIMULATED_NTC
	  tristate "Simulated NTC temp driver"
	  default y
	  help
        Provide three thermal zones (front, frame and back) to get real shell temp.
```
